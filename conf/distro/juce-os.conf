## conf/distro/juce-os.conf
```bitbake
require conf/distro/poky.conf

DISTRO = "juce-os"
DISTRO_NAME = "JUCE OS"
DISTRO_VERSION = "1.0"
DISTRO_CODENAME = "juce"
SDK_VERSION = "${DISTRO_VERSION}"

MAINTAINER = "Felipe F. Tonello <felipe.tonello@roli.com>"
POKY_DEFAULT_DISTRO_FEATURES = "${JUCE_OS_DISTRO_FEATURES}"
POKY_DEFAULT_EXTRA_RRECOMMENDS = ""
DISTRO_FEATURES_DEFAULT_remove = "nfc wifi 3g zeroconf x11 wayland"
```
